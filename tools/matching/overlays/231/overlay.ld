OUTPUT_ARCH(mips)

SECTIONS
{
	.overlay __overlay_load_address :
	{
		LONG(__overlay_id)
		*(.RB_names)
		*(.RB_MakeInstanceReflective)
		*(.RB_Player_KillPlayer)
		*(.RB_Player_ModifyWumpa)
		*(.RB_MinePool_Init)
		*(.RB_MinePool_Remove)
		*(.RB_MinePool_Add)
		*(.RB_Hazard_HurtDriver)
		*(.RB_Hazard_CollideWithDrivers)
		*(.RB_Hazard_CollideWithBucket)
		*(.RB_Hazard_ThCollide_Generic_Alt)
		*(.RB_Hazard_ThCollide_Missile)
		*(.RB_Hazard_ThCollide_Generic)
		*(.RB_Potion_OnShatter_TeethCallback)
		*(.RB_Potion_OnShatter_TeethSearch)
		*(.RB_Potion_ThTick_InAir)
		*(.RB_GenericMine_LInB)
		*(.RB_GenericMine_ThTick)
		*(.RB_GenericMine_ThDestroy)
		*(.RB_TNT_ThTick_ThrowOffHead)
		*(.RB_TNT_ThTick_SitOnHead)
		*(.RB_TNT_ThTick_ThrowOnHead)
		*(.RB_Explosion_ThTick)
		*(.RB_Hazard_CollLevInst)
		*(.RB_Hazard_InterpolateValue)
		*(.RB_MovingExplosive_ThTick)
		*(.RB_MovingExplosive_Explode)
		*(.RB_Warpball_FadeAway)
		*(.RB_Warpball_Death)
		*(.RB_Warpball_NewPathNode)
		*(.RB_Warpball_Start)
		*(.RB_Warpball_GetDriverTarget)
		*(.RB_Warpball_SetTargetDriver)
		*(.RB_Warpball_SeekDriver)
		*(.RB_Warpball_TurnAround)
		*(.RB_Warpball_ThTick)
		*(.RB_MaskWeapon_FadeAway)
		*(.RB_MaskWeapon_ThTick)
		*(.RB_ShieldDark_ThTick_Pop)
		*(.RB_ShieldDark_ThTick_Grow)
		*(.RB_Player_ToggleInvisible)
		*(.RB_Player_ToggleFlicker)
		*(.RB_RainCloud_FadeAway)
		*(.RB_RainCloud_ThTick)
		*(.RB_RainCloud_Init)
		*(.RB_Explosion_InitPotion)
		*(.RB_Explosion_InitGeneric)
		*(.RB_Blowup_ProcessBucket)
		*(.RB_Blowup_ThTick)
		*(.RB_Blowup_Init)
		*(.RB_Burst_ProcessBucket)
		*(.RB_Burst_ThTick)
		*(.RB_Burst_CollThBucket)
		*(.RB_Burst_CollLevInst)
		*(.RB_Burst_Init)
		*(.RB_Burst_DrawAll)
		*(.RB_GetThread_ClosestTracker)
		. = 0x6f6c;
		*RB_TNT.o(.rodata)
		/* Retail's shared tables precede the mine pool and level behaviors. */
		. = 0x70f4;
		*R231.o(.data)
		*D231.o(.bss)
		*RB_Baron.o(.rodata)
		*(.RB_Baron_ThTick)
		*(.RB_Baron_LInB)
		*RB_Blade.o(.rodata)
		*(.RB_Blade_ThTick)
		*(.RB_Blade_LInB)
		*(.RB_Bubbles_RoosTubes)
		*RB_Bubbles.o(.data)
		*RB_Crate.o(.data)
		*RB_Crate.o(.rodata)
		*RB_Crystal.o(.rodata)
		*RB_CtrLetter.o(.rodata)
		*RB_Banner.o(.rodata)
		*(.RB_CrateAny_ThTick_Explode)
		*(.RB_CrateAny_ThTick_Grow)
		*(.RB_CrateWeapon_ThCollide)
		*(.RB_CrateWeapon_LInC)
		*(.RB_CrateFruit_ThCollide)
		*(.RB_CrateFruit_LInC)
		*(.RB_CrateTime_ThCollide)
		*(.RB_CrateTime_LInC)
		*(.RB_Crystal_ThCollide)
		*(.RB_Crystal_ThTick)
		*(.RB_Crystal_LInC)
		*(.RB_Crystal_LInB)
		*(.RB_Default_LInB)
		*(.RB_CtrLetter_ThCollide)
		*(.RB_CtrLetter_LInC)
		*(.RB_CtrLetter_ThTick)
		*(.RB_CtrLetter_LInB)
		*(.RB_Banner_Animate_Init)
		*(.RB_Banner_Animate_Play)
		*(.RB_Banner_ThTick)
		*(.RB_Banner_LInB)
		*RB_Crystal.o(.data)
		*RB_CtrLetter.o(.data)
		*RB_Armadillo.o(.rodata)
		*(.RB_Armadillo_ThTick_TurnAround)
		*(.RB_Armadillo_ThTick_Rolling)
		*(.RB_Armadillo_ThCollide)
		*(.RB_Armadillo_LInB)
		*RB_Fireball.o(.rodata)
		*(.RB_Fireball_ThTick)
		*(.RB_Fireball_ThCollide)
		*(.RB_Fireball_LInB)
		*RB_Fireball.o(.data)
		*RB_FlameJet.o(.rodata)
		*(.RB_FlameJet_Particles)
		*(.RB_FlameJet_ThTick)
		*(.RB_FlameJet_LInB)
		*RB_FlameJet.o(.data)
		*RB_Follower.o(.rodata)
		*(.RB_Follower_ProcessBucket)
		*(.RB_Follower_ThTick)
		*(.RB_Follower_Init)
		*RB_Fruit.o(.rodata)
		*(.RB_Fruit_ThTick)
		*(.RB_Fruit_ThCollide)
		*(.RB_Fruit_LInB)
		*(.RB_Fruit_LInC)
		*RB_Minecart.o(.rodata)
		*(.RB_Minecart_ThTick)
		*(.RB_Minecart_LInB)
		*RB_Minecart.o(.data)
		*RB_Orca.o(.rodata)
		*(.RB_Orca_ThTick)
		*(.RB_Orca_ThCollide)
		*(.RB_Orca_LInB)
		*RB_Orca.o(.data)
		*RB_Plant.o(.rodata)
		*(.RB_Plant_ThTick_Eat)
		*(.RB_Plant_ThTick_Grab)
		*(.RB_Plant_ThTick_Transition_HungryToRest)
		*(.RB_Plant_ThTick_Hungry)
		*(.RB_Plant_ThTick_Rest)
		*(.RB_Plant_LInB)
		*RB_Plant.o(.data)
		*RB_Seal.o(.rodata)
		*(.RB_Seal_ThTick_TurnAround)
		*(.RB_Seal_ThTick_Move)
		*(.RB_Seal_ThCollide)
		*(.RB_Seal_LInB)
		*RB_Snowball.o(.rodata)
		*(.RB_Snowball_ThTick)
		*(.RB_Snowball_LInB)
		*RB_Spider.o(.rodata)
		*(.RB_Spider_DrawWebs)
		*(.RB_Spider_ThTick)
		*(.RB_Spider_ThCollide)
		*(.RB_Spider_LInB)
		*RB_Spider.o(.data)
		*(.RB_StartText_ProcessBucket)
		*(.RB_StartText_LInB)
		*RB_Teeth.o(.rodata)
		*(.RB_Teeth_LInB)
		*(.RB_Teeth_BSP_Callback)
		*(.RB_Teeth_ThTick)
		*(.RB_Teeth_LInC)
		*(.RB_Teeth_OpenDoor)
		*RB_Turtle.o(.rodata)
		*(.RB_Turtle_ThTick)
		*(.RB_Turtle_LInC)
		*(.RB_Turtle_LInB)
		*(.RB_*)
		*(.text)
		*(.rodata)
		*(.data)
		*(.sdata)
	}
	ASSERT(R231 == __overlay_load_address + 0x70f4, "231 shared table placement")
	ASSERT(RB_MakeInstanceReflective == __overlay_load_address + 0xc0, "231 opening data extent")
	ASSERT(D231 == __overlay_load_address + 0x74ac, "231 mine pool placement")
	ASSERT(RB_Baron_ThTick == __overlay_load_address + 0x7730, "231 mine pool and Baron name extent")
	ASSERT(RB_CrateAny_ThTick_Explode == __overlay_load_address + 0x8314, "231 bubble and pickup data extent")
	ASSERT(crystalLightDir == __overlay_load_address + 0x9f78 && letterLightDir == __overlay_load_address + 0x9f80,
	       "231 pickup light table placement")
	ASSERT(emSet_Fireball == __overlay_load_address + 0xa954 && fjLightDir == __overlay_load_address + 0xaabc,
	       "231 Fireball emitter and FlameJet light placement")
	ASSERT(emSet_fjHeat == __overlay_load_address + 0xb0a4 && fjBounds == __overlay_load_address + 0xb350,
	       "231 FlameJet emitter and bounds placement")

	/DISCARD/ :
	{
		*(.bss) *(.sbss) *(COMMON)
		*(.reginfo) *(.MIPS.abiflags) *(.pdr)
		*(.gnu.attributes) *(.comment)
	}
}
