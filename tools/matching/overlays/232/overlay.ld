OUTPUT_ARCH(mips)

SECTIONS
{
	/* Keep shared tables loadable so the matcher verifies their generated bytes against R232. */
	.garage_tables __overlay_load_address + 0x5c : SUBALIGN(4)
	{
		*AH_Garage.o(.rodata)
	}
	.warppad_color_table __overlay_load_address + 0xbc : SUBALIGN(4)
	{
		*AH_Map.o(.rodata)
	}
	.door_scale_table __overlay_load_address + 0x9c : SUBALIGN(4)
	{
		*AH_Door.o(.rodata)
	}

	.overlay __overlay_load_address : SUBALIGN(4)
	{
		LONG(__overlay_id)
		*AH_WarpPad.o(.rodata)
		*R232.o(.data)
		*AH_MaskHint.o(.rodata)
		*(.rodata)
		*(.AH_WarpPad_GetSpawnPosRot)
		*(.AH_WarpPad_AllWarppadNum)
		*(.AH_WarpPad_MenuProc)
		*(.AH_WarpPad_SpinRewards)
		*(.AH_WarpPad_ThTick)
		*(.AH_WarpPad_ThDestroy)
		*(.AH_WarpPad_LInB)
		*(.AH_Garage_ThDestroy)
		*(.AH_Garage_Open)
		*(.AH_Garage_ThTick)
		*(.AH_Garage_LInB)
		*(.AH_SaveObj_ThDestroy)
		*(.AH_SaveObj_ThTick)
		*(.AH_SaveObj_LInB)
		*(.AH_Door_ThDestroy)
		*(.AH_Door_ThTick)
		*(.AH_Door_LInB)
		*(.AH_Map_LoadSave_Prim)
		*(.AH_Map_LoadSave_Full)
		*(.AH_Map_HubArrow)
		*(.AH_Map_HubArrowOuter)
		*(.AH_Map_HubItems)
		*(.AH_Map_Warppads)
		*(.AH_Map_Main)
		*(.AH_Pause_Destroy)
		*(.AH_Pause_Draw)
		*(.AH_Pause_Update)
		*(.AH_HintMenu_FiveArrows)
		*(.AH_HintMenu_MaskPosRot)
		*(.AH_HintMenu_MenuProc)
		*(.AH_MaskHint_Start)
		*(.AH_MaskHint_boolCanSpawn)
		*(.AH_MaskHint_SetAnim)
		*(.AH_MaskHint_SpawnParticles)
		*(.AH_MaskHint_LerpVol)
		*(.AH_MaskHint_Update)
		*(.AH_Sign_LInB)
		*(.AH_*)
		*(.text)
		*D232.o(.data)
		*(.data)
		*(.sdata)
	}

	/DISCARD/ :
	{
		*(.bss) *(.sbss) *(COMMON)
		*(.reginfo) *(.MIPS.abiflags) *(.pdr)
		*(.gnu.attributes) *(.comment)
	}
}
