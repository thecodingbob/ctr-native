OUTPUT_ARCH(mips)

R233 = __overlay_load_address;

SECTIONS
{
	.overlay __overlay_load_address : SUBALIGN(4)
	{
		LONG(__overlay_id)
		*(.CS_thread_names)
		__cs_thread_rodata = .;
		*CS_Thread.o(.rodata)
		. = __cs_thread_rodata + ALIGN(. - __cs_thread_rodata, 8);
		*CS_Camera.o(.rodata)
		*CS_Podium.o(.rodata)
		*(.CS_intro_names)
		*(.CS_Thread_Particles)
		*(.CS_ScriptCmd_ReadOpcode_GetShort)
		*(.CS_ScriptCmd_ReadOpcode_GetInt)
		*(.CS_ScriptCmd_ReadOpcode_GetInt_dup)
		*(.CS_ScriptCmd_ReadOpcode_Main)
		*(.CS_ScriptCmd_OpcodeNext)
		*(.CS_ScriptCmd_OpcodeAt)
		*(.CS_Instance_InitMatrix)
		*(.CS_Instance_GetFrameData)
		*(.CS_Instance_GetNumAnimFrames)
		*(.CS_Instance_SafeCheckAnimFrame)
		*(.CS_Instance_BoolPlaySound)
		*(.CS_DestroyPodium_StartDriving)
		*(.CS_Thread_UseOpcode)
		*(.CS_Thread_MoveOnPath)
		*(.CS_Thread_AnimateScale)
		*(.CS_Thread_InterpolateFramesMS)
		*(.CS_Thread_ThTick)
		*(.CS_LoadBossCallback)
		*(.CS_LoadBoss)
		*(.CS_Camera_ThTick_Boss)
		*(.CS_Camera_BoolGotoBoss)
		*(.CS_Camera_ThTick_Podium)
		*(.CS_Thread_Init)
		*(.CS_Podium_Prize_Spin)
		*(.CS_Podium_Prize_ThTick3)
		*(.CS_Podium_Prize_ThTick2)
		*(.CS_Podium_Prize_ThTick1)
		*(.CS_Podium_Prize_ThDestroy)
		*(.CS_Podium_Prize_Init)
		*(.CS_Podium_Stand_ThTick)
		*(.CS_Podium_Stand_Init)
		*(.CS_Podium_FullScene_Init)
		*(.CS_Thread_LInB)
		*(.CS_Cutscene_Start)
		*(.CS_BoxScene_InstanceSplitLines)
		*R233.o(.data)
		*CS_Garage.o(.rodata)
		*(.CS_garage_white)
		*(.CS_Garage_ZoomOut)
		*(.CS_Garage_MenuProc)
		*(.CS_Garage_GetMenuPtr)
		*(.CS_Garage_Init)
		*(.CS_garage_data)
		*(.CS_credits_names)
		*(.CS_Credits_AnimateCreditGhost)
		*(.CS_Credits_GetNextString)
		*(.CS_Credits_DestroyCreditGhost)
		*(.CS_Credits_DrawNames)
		*(.CS_Credits_DrawEpilogue)
		*(.CS_Credits_ThTick)
		*(.CS_Credits_ThDestroy)
		*(.CS_Credits_Init)
		*(.CS_Credits_IsTextValid)
		*(.CS_Credits_NewDancer)
		*(.CS_Credits_NewCreditGhosts)
		*(.CS_Credits_End)
		*(.CS_credits_data)
		*(.CS_*)
		*(.text)
		*(.data)
		*(.sdata)
	}

	/DISCARD/ :
	{
		*(.bss) *(.sbss) *(COMMON)
		*(.reginfo) *(.MIPS.abiflags) *(.pdr)
		*(.gnu.attributes) *(.comment)
	}
}
